## security/lockdown/Kconfig
```kconfig
config SECURITY_LOCKDOWN_LSM
	bool "Enable kernel lockdown LSM"
	depends on SECURITY
	select MODULE_SIG if MODULES
	help
	  Build the kernel lockdown LSM.

	  This LSM provides coarse enforcement of kernel lockdown policies,
	  preventing operations that could compromise kernel integrity or
	  confidentiality.

config SECURITY_LOCKDOWN_LSM_EARLY
	bool "Initialize lockdown LSM early"
	depends on SECURITY_LOCKDOWN_LSM
	help
	  Initialize the lockdown LSM before other LSMs.

	  This is useful when boot parameters must be enforced before the
	  security subsystem has fully initialized.

	  If unsure, say N.

choice
	prompt "Default kernel lockdown mode"
	default LOCK_DOWN_KERNEL_FORCE_NONE
	depends on SECURITY_LOCKDOWN_LSM
	help
	  Select the lockdown mode enabled by default. It may subsequently
	  be changed using the kernel command line or
	  /sys/kernel/security/lockdown.

config LOCK_DOWN_KERNEL_FORCE_NONE
	bool "None"
	help
	  Allow kernel modification and restricted kernel data access.

config LOCK_DOWN_KERNEL_FORCE_INTEGRITY
	bool "Integrity"
	help
	  Disable features that allow runtime modification of the running
	  kernel.

config LOCK_DOWN_KERNEL_FORCE_CONFIDENTIALITY
	bool "Confidentiality"
	help
	  Disable runtime kernel modification and access to confidential
	  kernel information from userspace.

endchoice
```
